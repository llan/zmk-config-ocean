## config/boards/shields/Kconfig.shield
```kconfig
config SHIELD_OCEAN_LEFT
    def_bool $(shields_list_contains,ocean_left)

config SHIELD_OCEAN_RIGHT
    def_bool $(shields_list_contains,ocean_right)
```

## config/boards/shields/ocean/Kconfig.defconfig
```kconfig
if SHIELD_OCEAN_LEFT

config ZMK_KEYBOARD_NAME
    default "Ocean"

config ZMK_SPLIT_ROLE_CENTRAL
    default y

endif

if SHIELD_OCEAN_LEFT || SHIELD_OCEAN_RIGHT

config ZMK_SPLIT
    default y

endif
```
